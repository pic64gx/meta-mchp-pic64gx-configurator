## conf/layer.conf
```bitbake
BBPATH .= ":${LAYERDIR}"

BBFILES += "${LAYERDIR}/recipes-*/*/*.bb \
            ${LAYERDIR}/recipes-*/*/*.bbappend"

BBFILE_COLLECTIONS += "meta_mchp_pic64gx_configurator"
BBFILE_PATTERN_meta_mchp_pic64gx_configurator = "^${LAYERDIR}/"
BBFILE_PRIORITY_meta_mchp_pic64gx_configurator = "5"
LAYERVERSION_meta_mchp_pic64gx_configurator = "4"
LAYERSERIES_COMPAT_meta_mchp_pic64gx_configurator = "scarthgap"

LAYERDEPENDS_meta_mchp_pic64gx_configurator = "meta-mchp-common meta-mchp-pic64-bsp zephyrcore zephyrbsp"
```
